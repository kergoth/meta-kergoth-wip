## conf/layer.conf
```bitbake
BBPATH .= ":${LAYERDIR}"
BBFILES += "${LAYERDIR}/recipes-*/*/*.bb \
            ${LAYERDIR}/recipes-*/*/*.bbappend"

# Layer-specific content which is only used when that layer is
# included in our configuration
BBFILES += "${@' '.join('${LAYERDIR}/%s/recipes*/*/*.%s' % (layer, ext) \
               for layer in '${BBFILE_COLLECTIONS}'.split() for ext in ['bb', 'bbappend'])}"

BBFILE_COLLECTIONS += "kergoth-wip"
BBFILE_PATTERN_kergoth-wip = "^${LAYERDIR}/"
BBFILE_PRIORITY_kergoth-wip = "1"

LICENSE_PATH += "${LAYERDIR}/licenses"
```

## meta-layer-feature-example/conf/layer.conf
```bitbake
# We have a conf and classes directory, add to BBPATH
BBPATH .= ":${LAYERDIR}"

# We have recipes-* directories, add to BBFILES
BBFILES += "${LAYERDIR}/recipes-*/*/*.bb \
            ${LAYERDIR}/recipes-*/*/*.bbappend"

BBFILE_COLLECTIONS += "meta-layer-feature-example"
BBFILE_PATTERN_meta-layer-feature-example = "^${LAYERDIR}/"
BBFILE_PRIORITY_meta-layer-feature-example = "1"

LAYERDEPENDS_meta-layer-feature-example = "core"
LAYERSERIES_COMPAT_meta-layer-feature-example = "dunfell zeus gatesgarth"

INHERIT_append = " feature_overrides"
FEATUREOVERRIDES .= "${@bb.utils.contains('LAYER_FEATURES', 'example-1', ':feature-example-1', '', d)}"
FEATUREOVERRIDES .= "${@bb.utils.contains('DISTRO_FEATURES', 'example-2', ':feature-example-2', '', d)}"
FEATUREOVERRIDES .= "${@bb.utils.contains('MACHINE_FEATURES', 'example-3', ':feature-example-3', '', d)}"
FEATUREOVERRIDES .= "${@bb.utils.contains('COMBINED_FEATURES', 'example-4', ':feature-example-4', '', d)}"
```

## meta-minimal-exports-pkgconfig/conf/layer.conf
```bitbake
# We have a conf and classes directory, add to BBPATH
BBPATH .= ":${LAYERDIR}"

# We have recipes-* directories, add to BBFILES
BBFILES += "${LAYERDIR}/recipes-*/*/*.bb \
	${LAYERDIR}/recipes-*/*/*.bbappend"

BBFILE_COLLECTIONS += "meta-minimal-exports-pkgconfig"
BBFILE_PATTERN_meta-minimal-exports-pkgconfig = "^${LAYERDIR}/"
BBFILE_PRIORITY_meta-minimal-exports-pkgconfig = "10"
LAYERDEPENDS_meta-minimal-exports-pkgconfig = "meta-minimal-exports"
```

## meta-minimize-packageconfigs/conf/layer.conf
```bitbake
# We have a conf and classes directory, add to BBPATH
BBPATH .= ":${LAYERDIR}"

# We have recipes-* directories, add to BBFILES
BBFILES += "${LAYERDIR}/recipes-*/*/*.bb \
	${LAYERDIR}/recipes-*/*/*.bbappend"

BBFILE_COLLECTIONS += "minimize-packageconfigs"
BBFILE_PATTERN_minimize-packageconfigs = "^${LAYERDIR}/"
BBFILE_PRIORITY_minimize-packageconfigs = "1"
```

## meta-musl-nativesdk/conf/distro/include/sdklibc-musl.conf
```bitbake
SDKLIBCEXTENSION = "-musl"

PREFERRED_PROVIDER_virtual/nativesdk-libc ?= "nativesdk-musl"
PREFERRED_PROVIDER_virtual/nativesdk-libintl ?= "nativesdk-musl"
PREFERRED_PROVIDER_virtual/nativesdk-libiconv ?= "nativesdk-musl"
PREFERRED_PROVIDER_virtual/nativesdk-crypt ?= "nativesdk-musl"

CXXFLAGS_append_class-nativesdk = " -fvisibility-inlines-hidden"
SDKIMAGE_LINGUAS = ""
```

## meta-musl-nativesdk/conf/layer.conf
```bitbake
# We have a conf and classes directory, add to BBPATH
BBPATH .= ":${LAYERDIR}"

# We have recipes-* directories, add to BBFILES
BBFILES += "${LAYERDIR}/recipes-*/*/*.bb \
	${LAYERDIR}/recipes-*/*/*.bbappend"

BBFILE_COLLECTIONS += "musl-nativesdk"
BBFILE_PATTERN_musl-nativesdk = "^${LAYERDIR}/"
BBFILE_PRIORITY_musl-nativesdk = "7"

LAYERDIR_musl-nativesdk = "${LAYERDIR}"
```

## meta-pkgconf/conf/layer.conf
```bitbake
# We have a conf and classes directory, add to BBPATH
BBPATH .= ":${LAYERDIR}"

# We have recipes-* directories, add to BBFILES
BBFILES += "${LAYERDIR}/recipes-*/*/*.bb \
	${LAYERDIR}/recipes-*/*/*.bbappend"

BBFILE_COLLECTIONS += "meta-pkgconf"
BBFILE_PATTERN_meta-pkgconf = "^${LAYERDIR}/"
BBFILE_PRIORITY_meta-pkgconf = "1"

LICENSE_PATH += "${LAYERDIR}/licenses"
```

## meta-setup-scripts-mentor/conf/layer.conf
```bitbake
# We have a conf and classes directory, add to BBPATH
BBPATH .= ":${LAYERDIR}"

# We have recipes-* directories, add to BBFILES
BBFILES += "${LAYERDIR}/recipes-*/*/*.bb \
	${LAYERDIR}/recipes-*/*/*.bbappend"

BBFILE_COLLECTIONS += "setup-scripts-mentor"
BBFILE_PATTERN_setup-scripts-mentor = "^${LAYERDIR}/"
BBFILE_PRIORITY_setup-scripts-mentor = "1"
```
